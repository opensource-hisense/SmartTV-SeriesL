## linux-4.4/drivers/sni/wifi/rtl8188FU/Kconfig
```kconfig
config RTL8188FU
	tristate "Realtek 8188F USB WiFi"
	depends on USB
	select WIRELESS_EXT
	select WEXT_SPY
	select WEXT_PRIV
	---help---
	  Help message of RTL8818FU
```
